## conf/bblayers.conf
```bitbake
# POKY_BBLAYERS_CONF_VERSION is increased each time build/conf/bblayers.conf
# changes incompatibly
POKY_BBLAYERS_CONF_VERSION = "2"

BBPATH = "${TOPDIR}"
BBFILES ?= ""

BBLAYERS ?= " \
  ${TOPDIR}/../poky/meta \
  ${TOPDIR}/../poky/meta-poky \
  ${TOPDIR}/../poky/meta-yocto-bsp \
  ${TOPDIR}/../meta-tegra \
  ${TOPDIR}/../meta-frc971 \
  ${TOPDIR}/../meta-openembedded/meta-multimedia \
  ${TOPDIR}/../meta-openembedded/meta-python \
  ${TOPDIR}/../meta-openembedded/meta-oe \
  "
```

## conf/machine/orin-nx-8g.conf
```bitbake
#@TYPE: Machine
#@NAME: Nvidia Jetson Orin NX
#@DESCRIPTION: Nvidia Jetson Orin NX module in P3509 carrier

TEGRA_BOARDID ?= "3767"
TEGRA_FAB ?= "300"
TEGRA_BOARDSKU ?= "0001"
TEGRA_BOARDREV ?= "N.2"
TEGRA_CHIPREV ?= "1"
NVPMODEL ?= "nvpmodel_p3767_0001"
NVFANCONTROL ?= "nvfancontrol_p3767_0000"

TNSPEC_BOOTDEV ?= "nvme0n1p1"

TEGRAFLASH_NO_INTERNAL_STORAGE = "1"

require conf/machine/include/tegra234.inc
require conf/machine/include/devkit-wifi.inc

TEGRA_BUPGEN_SPECS ?= "fab=000;boardsku=0000;boardrev=;bup_type=bl \
                       fab=000;boardsku=0000;boardrev=;bup_type=kernel \
                       fab=000;boardsku=0001;boardrev=;bup_type=bl \
                       fab=000;boardsku=0001;boardrev=;bup_type=kernel \
                       fab=000;boardsku=0003;boardrev=;bup_type=bl \
                       fab=000;boardsku=0003;boardrev=;bup_type=kernel \
                       fab=000;boardsku=0004;boardrev=;bup_type=bl \
                       fab=000;boardsku=0004;boardrev=;bup_type=kernel \
                       fab=000;boardsku=0005;boardrev=;bup_type=bl \
                       fab=000;boardsku=0005;boardrev=;bup_type=kernel"

KERNEL_DEVICETREE ?= "tegra234-p3767-0001-p3509-a02.dtb"
# TODO(austin): Rip out console + mminit arg when we are happier so it boots faster.
KERNEL_ARGS ?= "mminit_loglevel=4 console=ttyTCU0,115200 console=ttyAMA0,115200 firmware_class.path=/etc/firmware fbcon=map:0 net.ifnames=0 nospectre_bhb"
MACHINE_EXTRA_RRECOMMENDS += "kernel-module-r8168 kernel-module-r8169 kernel-module-realtek"
MACHINE_EXTRA_RDEPENDS += "linux-firmware-rtl8168"

EMMC_SIZE ?= ""
BOOTPART_SIZE ?= "8388608"
# 55GiB default rootfs size
#ROOTFSPART_SIZE ?= "59055800320"
ROOTFSPART_SIZE_DEFAULT ?= "8589934592"
ODMDATA ?= "gbe-uphy-config-8,hsstp-lane-map-3,hsio-uphy-config-0"
EMMC_BCT ?= "tegra234-p3767-0001-sdram-l4t.dts"
NVIDIA_BOARD ?= "t186ref"
PARTITION_LAYOUT_TEMPLATE = "flash_t234_qspi.xml"
PARTITION_LAYOUT_EXTERNAL = "flash_l4t_external.xml"
TEGRA_AUDIO_DEVICE ?= "tegra-hda-p3767-p3509"

OTABOOTDEV ?= "/dev/mtdblock0"
OTAGPTDEV ?= "/dev/mtdblock0"

#TEGRA_PLUGIN_MANAGER_OVERLAYS ?= "tegra234-p3767-overlay.dtbo tegra234-p3767-0000-p3509-a02-hdr40.dtbo jetson-mcp251x-overlay.dtbo tegra234-p3767-camera-imx477-dual.dtbo"
#TEGRA_PLUGIN_MANAGER_OVERLAYS ?= "tegra234-p3767-overlay.dtbo tegra234-p3767-camera-imx296-dual.dtbo"
#TEGRA_PLUGIN_MANAGER_OVERLAYS ?= "tegra234-p3767-overlay.dtbo tegra234-p3767-camera-imx477-dual.dtbo"
TEGRA_PLUGIN_MANAGER_OVERLAYS ?= "tegra234-p3767-overlay.dtbo tegra234-p3767-camera-imx296-imx477.dtbo"
```
